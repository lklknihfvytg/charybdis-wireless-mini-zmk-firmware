## boards/shields/charybdis_bt/Kconfig.defconfig
```kconfig
if SHIELD_CHARYBDIS_RIGHT_BT
config ZMK_KEYBOARD_NAME
    default "Charybdis"
config ZMK_SPLIT_ROLE_CENTRAL
    default y
endif

if SHIELD_CHARYBDIS_LEFT_BT || SHIELD_CHARYBDIS_RIGHT_BT
config ZMK_SPLIT
    default y
endif
```

## boards/shields/charybdis_bt/Kconfig.shield
```kconfig
config SHIELD_CHARYBDIS_LEFT_BT
	def_bool $(shields_list_contains,charybdis_left_bt)

config SHIELD_CHARYBDIS_RIGHT_BT
	def_bool $(shields_list_contains,charybdis_right_bt)
```

## boards/shields/charybdis_dongle/Kconfig.defconfig
```kconfig
if SHIELD_CHARYBDIS_DONGLE_CENTRAL
config ZMK_KEYBOARD_NAME
    default "Charybdis"
config ZMK_SPLIT_ROLE_CENTRAL
    default y
endif

if SHIELD_CHARYBDIS_LEFT_DONGLE || SHIELD_CHARYBDIS_RIGHT_DONGLE || SHIELD_CHARYBDIS_DONGLE_CENTRAL
config ZMK_SPLIT
    default y
endif
```

## boards/shields/charybdis_dongle/Kconfig.shield
```kconfig
config SHIELD_CHARYBDIS_LEFT_DONGLE
	def_bool $(shields_list_contains,charybdis_left_dongle)

config SHIELD_CHARYBDIS_RIGHT_DONGLE
	def_bool $(shields_list_contains,charybdis_right_dongle)

config SHIELD_CHARYBDIS_DONGLE_CENTRAL
	def_bool $(shields_list_contains,charybdis_dongle_central)
```

## config/Kconfig
```kconfig
config ZMK_BEHAVIOR_BATTERY_TEXT
	bool "Battery text behavior"
	depends on DT_HAS_ZMK_BEHAVIOR_BATTERY_TEXT_ENABLED
	default y

config CHARYBDIS_SCROLL_SNAP
	bool "Charybdis scroll axis lock"
	default y
	depends on DT_HAS_CHARYBDIS_INPUT_PROCESSOR_SCROLL_SNAP_ENABLED
	depends on ZMK_POINTING && (!ZMK_SPLIT || ZMK_SPLIT_ROLE_CENTRAL)

config CHARYBDIS_AUTO_MOUSE
	bool "Guarded automatic mouse layer"
	default y
	depends on DT_HAS_CHARYBDIS_INPUT_PROCESSOR_AUTO_MOUSE_ENABLED
	depends on ZMK_POINTING && (!ZMK_SPLIT || ZMK_SPLIT_ROLE_CENTRAL)
```

## config/dts/bindings/behaviors/zmk,behavior-battery-text.yaml
```yaml
# Copyright (c) 2026 The ZMK Contributors
# SPDX-License-Identifier: MIT

description: Type the cached split peripheral battery levels as two numbers.

compatible: "zmk,behavior-battery-text"

include: zero_param.yaml
```

## config/dts/bindings/input_processors/charybdis,input-processor-auto-mouse.yaml
```yaml
description: Automatic mouse layer guarded by physical typing and deliberate motion
compatible: "charybdis,input-processor-auto-mouse"
include: ip_zero_param.yaml

properties:
  layer:
    type: int
    required: true
  click-positions:
    type: array
    required: true
    description: Physical positions allowed to click without cancelling the layer
  require-prior-idle-ms:
    type: int
    default: 1000
  activation-distance:
    type: int
    default: 80
    description: Net raw movement along one axis within the activation window
  activation-window-ms:
    type: int
    default: 200
  timeout-ms:
    type: int
    default: 800
```

## config/dts/bindings/input_processors/charybdis,input-processor-scroll-snap.yaml
```yaml
description: Lock trackball scrolling to the dominant axis of a gesture
compatible: "charybdis,input-processor-scroll-snap"
include: ip_zero_param.yaml

properties:
  activation-distance:
    type: int
    default: 4
    description: Net sensor counts before choosing an axis, before scroll scaling
  idle-reset-ms:
    type: int
    default: 200
    description: Pause between gestures that permits choosing a new axis
```

## config/west.yml
```yaml
manifest:
  remotes:
    - name: zmkfirmware
      url-base: https://github.com/zmkfirmware

    - name: 280Zo
      url-base: https://github.com/280Zo

  projects:
    - name: zmk
      remote: zmkfirmware
      revision: 4dd95d7840eb3d5a3f59bb29fbf1ab054715ef85
      import:
        file: app/west.yml
        name-blocklist:
          - tflite-micro
          - thrift

    - name: zmk-pmw3610-driver
      remote: 280Zo
      revision: f6e234367b22508b5c0a6bcc82437c64f320089b

  self:
    path: config
```
